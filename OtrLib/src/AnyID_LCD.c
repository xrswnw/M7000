#include "AnyID_LCD.h"

LCD_FONT g_stFont;



const unsigned char g_aLCDAscII[128][16]={
{0x00,0x00,0x00,0x00,0x00,0x00,0x00,0x00,0x00,0x00,0x00,0x00,0x00,0x00,0x00,0x00},
{0x00,0x00,0x00,0x00,0x00,0x00,0x00,0x00,0x00,0x00,0x00,0x00,0x00,0x00,0x00,0x00},
{0x00,0x00,0x00,0x00,0x00,0x00,0x00,0x00,0x00,0x00,0x00,0x00,0x00,0x00,0x00,0x00},
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{0x00,0x60,0x80,0x80,0x40,0x40,0x20,0x20,0x00,0x00,0x00,0x00,0x00,0x00,0x00,0x00},/*"~",94*/
};

//该液晶的RAM比较少，所以使用一个BUFFER和液晶内部的RAM进行同步
//这样就不必从液晶内部读取数据
u8 LCD_RAM[LCD_PAGE_NUM][LCD_COLUMN_NUM] = {0};

void LCD_Init(void)
{
    LCD_RST_L();
    LCD_Delay(0xff);
    LCD_RST_H();

    LCD_WriteByte(0x84, LCD_WTYPE_CMD);
	LCD_WriteByte(0x07, LCD_WTYPE_CMD); 	
	LCD_WriteByte(0x82, LCD_WTYPE_CMD);
	LCD_WriteByte(0x03, LCD_WTYPE_CMD);
	LCD_WriteByte(0x85, LCD_WTYPE_CMD);
	LCD_WriteByte(0x0A, LCD_WTYPE_CMD);
	LCD_WriteByte(0xA0, LCD_WTYPE_CMD);
	LCD_WriteByte(0xC0, LCD_WTYPE_CMD);
	LCD_WriteByte(0xA6, LCD_WTYPE_CMD);
	LCD_WriteByte(0x26, LCD_WTYPE_CMD);
	LCD_WriteByte(0x81, LCD_WTYPE_CMD);
	LCD_WriteByte(0x1F, LCD_WTYPE_CMD);
	LCD_WriteByte(0x2F, LCD_WTYPE_CMD);
	LCD_WriteByte(0xA4, LCD_WTYPE_CMD);	
	LCD_WriteByte(0xAf, LCD_WTYPE_CMD);

    LCD_ClearScreen();

    LCD_SetFontSize(8, 16);
    LCD_BLA_OFF();
}

void LCD_SetStartPos(u8 x, u8 y)
{
    x += LCD_X_START;

    LCD_WriteByte(0xB0 | (7 - y),  LCD_WTYPE_CMD);     //Y坐标写入,页地址写入Page

	LCD_WriteByte(0x10 | (x >> 4), LCD_WTYPE_CMD);          // X坐标写入(高四位)
	LCD_WriteByte(0x00 | (x & 0x0f), LCD_WTYPE_CMD);        // 低四位
}

void LCD_ClearScreen(void)
{
    u8 i = 0;
    u8 j = 0;

    for(i = 0; i < LCD_PAGE_NUM; i++)
    {
        LCD_SetStartPos(0, i);
        for(j = 0; j < LCD_COLUMN_NUM; j++)
        {
            LCD_WriteByte(0x00, LCD_WTYPE_DATA);
        }
    }
}

void LCD_WriteRAM(u8 x, u8 y)
{
    u8 data = 0;

    data = 0x80 >> (y % LCD_PIX_PRE_PAGE);
    LCD_WriteByte(data | LCD_RAM[y / LCD_PIX_PRE_PAGE][x], LCD_WTYPE_DATA);
	LCD_RAM[y / LCD_PIX_PRE_PAGE][x] = data | LCD_RAM[y / LCD_PIX_PRE_PAGE][x];
}

void LCD_DisplayOn(void)
{
    LCD_WriteByte(0xAF, LCD_WTYPE_CMD);
    LCD_BLA_ON();
}
void LCD_DisplayOff(void)
{
    LCD_WriteByte(0xAE, LCD_WTYPE_CMD);
    LCD_BLA_OFF();
}


void LCD_DrawPix(u8 x, u8 y, BOOL bClear)
{
    u8 data = 0;
    u8 page = 0;
    u8 bit = 0;

    if(y >= LCD_LINE_NUM)
    {
        y = 0;
    }
    page = y / LCD_PIX_PRE_PAGE;
    bit = y % LCD_PIX_PRE_PAGE;

    if(x >= LCD_COLUMN_NUM)
    {
        x = 0;
    }

    LCD_SetStartPos(x, page);

    data = 0x80 >> bit;
    if(bClear)
    {
        data = ~data;
        data &= LCD_RAM[page][x];
    }
    else
    {
        data |= LCD_RAM[page][x];
    }
    LCD_WriteByte(data, LCD_WTYPE_DATA);
    LCD_RAM[page][x] = data;

}

void LCD_DrawLine(u8 x0, u8 y0, u8 x1, u8 y1, BOOL bClear)
{
    int dy = y1 - y0;
	int dx = x1 - x0;
	int stepx, stepy;

    if (dy < 0)
    {
        dy = -dy;
        stepy = -1;
    }
    else
    {
        stepy = 1;
    }
    if (dx < 0)
    {
        dx = -dx;
        stepx = -1;
    }
    else
    {
        stepx = 1;
    }

    dy <<= 1; // dy is now 2*dy
	dx <<= 1; // dx is now 2*dx
	LCD_DrawPix(x0, y0, bClear);
	if(dx > dy)
	{
		int fraction = dy - (dx >> 1); // same as 2*dy - dx
		while(x0 != x1)
		{
			if(fraction >= 0)
			{
				y0 += stepy;
				fraction -= dx; // same as fraction -= 2*dx
			}
			x0 += stepx;
			fraction += dy; // same as fraction -= 2*dy
			LCD_DrawPix(x0, y0, bClear);
		}
	}
	else
	{
		int fraction = dx - (dy >> 1);
		while(y0 != y1)
		{
			if(fraction >= 0)
			{
				x0 += stepx;
				fraction -= dy;
			}
			y0 += stepy;
			fraction += dx;
			LCD_DrawPix(x0, y0, bClear);;
		}
	}
}

void LCD_DrawRect(u8 x0, u8 y0, u8 x1, u8 y1, BOOL bFill, BOOL bClear)

{
    if(bFill)
    {
		u8 xmax, xmin, ymax, ymin;
        xmin = (x0 <= x1) ? x0 : x1;
		xmax = (x0 > x1) ? x0 : x1;
		ymin = (y0 <= y1) ? y0 : y1;
		ymax = (y0 > y1) ? y0 : y1;

		x0 = xmin;
		x1 = xmax;
		y0 = ymin;
		y1 = ymax;
		
        x1 += 1;
        y1 += 1;

        for(; y0 < y1; y0++)
        {
            for(x0 = xmin; x0 < x1; x0++)
            {
                LCD_DrawPix(x0, y0, bClear);
            }
        }

    }
    else
    {
        LCD_DrawLine(x0, y0, x1, y0, bClear);
        LCD_DrawLine(x1, y0, x1, y1, bClear);
        LCD_DrawLine(x1, y1, x0, y1, bClear);
        LCD_DrawLine(x0, y1, x0, y0, bClear);
    }
}


void LCD_DrawCircle(u8 x0, u8 y0, u8 r, BOOL bFill, BOOL bClear)
{
	int f = 1 - r;
	int ddF_x = 0;
	int ddF_y = -2 * r;
	int x = 0;
	int y = r;
	
	LCD_DrawPix(x0, y0 + r, bClear);
	LCD_DrawPix(x0, y0 - r, bClear);
	LCD_DrawPix(x0 + r, y0, bClear);
	LCD_DrawPix(x0 - r, y0, bClear);

    if(bFill)
    {
        LCD_DrawLine(x0 - r, y0, x0 + r, y0, bClear);
    }
	while(x < y)
	{
		if (f >= 0)
		{
			y--;
			ddF_y += 2;
			f += ddF_y;
		}
		x++;
		ddF_x += 2;
		f += ddF_x + 1;
		LCD_DrawPix(x0 + x, y0 + y, bClear);
		LCD_DrawPix(x0 - x, y0 + y, bClear);
		LCD_DrawPix(x0 + x, y0 - y, bClear);
		LCD_DrawPix(x0 - x, y0 - y, bClear);
		LCD_DrawPix(x0 + y, y0 + x, bClear);
		LCD_DrawPix(x0 - y, y0 + x, bClear);
		LCD_DrawPix(x0 + y, y0 - x, bClear);
		LCD_DrawPix(x0 - y, y0 - x, bClear);

        if(bFill)
        {
            LCD_DrawLine(x0 - y, y0 + x, x0 + y, y0 + x, bClear);
            LCD_DrawLine(x0 - y, y0 - x, x0 + y, y0 - x, bClear);
            LCD_DrawLine(x0 - x, y0 + y, x0 + x, y0 + y, bClear);
            LCD_DrawLine(x0 - x, y0 - y, x0 + x, y0 - y, bClear);
        }
	}
}


void LCD_SetFontSize(u8 w, u8 h)
{
    g_stFont.fontSize.w = w;
    g_stFont.fontSize.h = h;
}

void LCD_DrawFont(u8 x0, u8 y0, u8 *pFont)
{
    u8 w = 0, h = 0;
    u8 i = 0, j = 0;

    w = g_stFont.fontSize.w;
    h = g_stFont.fontSize.h;

    h = ((h - 1) >> 3) + 1;

    y0 = y0 / LCD_PIX_PRE_PAGE;

    for(i = 0; i < h; i++)
    {
        LCD_SetStartPos(x0, y0 + i);

        for(j = 0; j < w; j++)
        {
            LCD_RAM[y0 + i][x0 + j] = pFont[(i * w) + j];
            LCD_WriteByte(LCD_RAM[y0 + i][x0 + j], LCD_WTYPE_DATA);
        }
    }
}
//这个程序有Bug：系统不知道显示区的起始x位置和起始y位置
void LCD_DrawString(u8 x0, u8 y0, u8 maxNum, u8 num, u8 *pString, u8 *pFont)
{
    u8 fontBytes = 0;
    u8 line = 0;
    u8 x = 0, y = 0;

    fontBytes = (g_stFont.fontSize.w * g_stFont.fontSize.h) >> 3;
    line = ((num - 1) / maxNum) + 1;

    for(y = 1; y < line; y++)
    {
        for(x = 0; x < maxNum; x++)
        {
            LCD_DrawFont(x0, y0, pFont + pString[(y - 1) * maxNum + x] * fontBytes);
			x0 += g_stFont.fontSize.w;
			num--;
        }
		x0 -= (maxNum * g_stFont.fontSize.w);
		y0 += g_stFont.fontSize.h;
    }

    for(x = 0; x < num; x++)
    {
        LCD_DrawFont(x0, y0, pFont + pString[(y - 1) * maxNum + x] * fontBytes);
		x0 += g_stFont.fontSize.w;
    }

}


