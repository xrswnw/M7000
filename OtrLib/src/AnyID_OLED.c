#include "AnyID_OLED.h"

const u8 g_aOLEDASCII[96 * 16] =
{
0x00,0x00,0x00,0x00,0x00,0x00,0x00,0x00,0x00,0x00,0x00,0x00,0x00,0x00,0x00,0x00,//" ",0

0x00,0x00,0x00,0x10,0x10,0x10,0x10,0x10,0x10,0x10,0x10,0x00,0x00,0x10,0x00,0x00,//"!",1
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0x00,0x00,0x00,0x00,0x00,0x00,0x00,0x00,0x00,0x00,0x00,0x00,0x00,0x00,0x00,0x00,//"",95
};

void OLED_Init(void)
{
    OLED_Enable();
    
    OLED_Reset();

    OLED_SetCommandLock(OLED_UNLOCK_CMD);       // Unlock Basic Commands (0x12/0x16)

    OLED_SetDisplayOff();                       // Display Off (0x00/0x01)

    OLED_SetDisplayClock(0xF1);                 // Set Clock as 80 Frames/Sec
    OLED_SetMultiplexRatio(0x3F);               // 1/64 Duty (0x0F~0x3F)
    OLED_SetDisplayOffset(0x00);                // Shift Mapping RAM Counter (0x00~0x3F)
    OLED_SetStartLine(0x00);                    // Set Mapping RAM Display Start Line (0x00~0x7F)
    OLED_SetRemapFormat(OLED_REMAP_SCAN_N_2_1 | OLED_REMAP_ENABLE_NIBBLE);              // Set Horizontal Address Increment
                                                                                        // Column Address 0 Mapped to SEG0
                                                                                        // Enable Nibble Remap
                                                                                        // Scan from COM[N-1] to COM0
                                                                                        // Disable COM Split Odd Even
                                                                                        // Enable Dual COM Line Mode

    // Disable GPIO Pins Input
    OLED_SetGPIO(OLED_GPIO0_DISIN_HIZ | OLED_GPIO1_DISIN_HIZ);
    OLED_SetFunctionSelection(OLED_VDD_INTERNAL);                   // Enable Internal VDD Regulator
    OLED_SetDisplayEnhancementA(OLED_VSL_EXTERNAL, OLED_GRAY_LOW);  // Enable External VSL
                                                                    // Set Low Gray Scale Enhancement
    OLED_SetContrastCurrent(0xFF);                                  // Set Segment Output Current
    OLED_SetMasterCurrent(OLED_BRIGHTNESS);                         // Set Scale Factor of Segment Output Current Control
    OLED_SetGrayScaleTable();                                       // Set Pulse Width for Gray Scale Table
    OLED_SetPhaseLength(0xF2);                                      // Set Phase 1 as 5 Clocks & Phase 2 as 14 Clocks
    OLED_SetDisplayEnhancementB(OLED_ENHANCEB_NORMAL);              // Enhance Driving Scheme Capability (0x00/0x20)
    OLED_SetPrechargeVoltage(0x1F);                                 // Set Pre-Charge Voltage Level as 0.60*VCC
    OLED_SetPrechargePeriod(0x08);                                  // Set Second Pre-Charge Period as 8 Clocks
    OLED_SetVCOMH(0x07);                                            // Set Common Pins Deselect Voltage Level as 0.86*VCC
    OLED_SetDisplayMode(OLED_DIS_NORMAL);                           // Normal Display Mode (0x00/0x01/0x02/0x03)
    OLED_SetPartialDisplay(OLED_PART_DIS_DISABLE, 0x00, 0x00);      // Disable Partial Display

    OLED_FillRAM(OLED_X_PIX_MAX, OLED_Y_PIX_MAX, 0x00);             // Clear Screen

    OLED_SetDisplayOff();                                           // Display On (0x00/0x01)
}

void OLED_SetColAdd(u8 start, u8 end)
{
    OLED_WriteByte(OLED_CMD_SET_COL_ADDR, OLED_WTYPE_CMD);          // Set Column Address
    OLED_WriteByte(start, OLED_WTYPE_DATA);                         // Default => 0x00
    OLED_WriteByte(end, OLED_WTYPE_DATA);                           // Default => 0x77
}

void OLED_SetRowAdd(u8 start, u8 end)
{
    OLED_WriteByte(OLED_CMD_SET_ROW_ADDR, OLED_WTYPE_CMD);          // Set Row Address
    OLED_WriteByte(start, OLED_WTYPE_DATA);                         // Default => 0x00
    OLED_WriteByte(end, OLED_WTYPE_DATA);                           // Default => 0x7F
}
void OLED_SetWriteRAM(void)
{
    OLED_WriteByte(OLED_CMD_SET_WRAM, OLED_WTYPE_CMD);              // Enable MCU to Write into RAM
}
void OLED_SetReadRAM(void)
{
    OLED_WriteByte(OLED_CMD_SET_RRAM, OLED_WTYPE_CMD);              // Enable MCU to Read from RAM
}


void OLED_SetRemapFormat(u8 fmt)
{
    OLED_WriteByte(OLED_CMD_SET_REMAP_MODE, OLED_WTYPE_CMD);        // Set Re-Map / Dual COM Line Mode
    OLED_WriteByte(fmt, OLED_WTYPE_DATA);                           // Default => 0x40
                                                                    // Horizontal Address Increment
                                                                    // Column Address 0 Mapped to SEG0
                                                                    // Disable Nibble Remap
                                                                    // Scan from COM0 to COM[N-1]
                                                                    // Disable COM Split Odd Even
                                                                    // Default => 0x01 (Disable Dual COM Mode)
    OLED_WriteByte(OLED_REMAP_ENABLE_DUAL_COM, OLED_WTYPE_DATA);
}


void OLED_SetStartLine(u8 start)
{
    OLED_WriteByte(OLED_CMD_SET_DSTART_LINE, OLED_WTYPE_CMD);       // Set Vertical Scroll by RAM
    OLED_WriteByte(start, OLED_WTYPE_DATA);                         // Default => 0x00
}


void OLED_SetDisplayOffset(u8 offset)
{
    OLED_WriteByte(OLED_CMD_SET_DOFFSET, OLED_WTYPE_CMD);           // Set Vertical Scroll by Row
    OLED_WriteByte(offset, OLED_WTYPE_DATA);                        // Default => 0x00
}


void OLED_SetDisplayMode(u8 mode)
{
    OLED_WriteByte(OLED_CMD_SET_DIS_MODE | mode, OLED_WTYPE_CMD);   // Set Display Mode
                                                                    // Default => 0xA4
                                                                    // 0xA4 (0x00) => Entire Display Off, All Pixels Turn Off
                                                                    // 0xA5 (0x01) => Entire Display On, All Pixels Turn On at GS Level 15
                                                                    // 0xA6 (0x02) => Normal Display
                                                                    // 0xA7 (0x03) => Inverse Display
}


void OLED_SetPartialDisplay(u8 bEnalbe, u8 start, u8 end)
{
    OLED_WriteByte(OLED_CMD_SET_PART_DIS | bEnalbe, OLED_WTYPE_CMD);

    if(bEnalbe == OLED_PART_DIS_ENABLE)
    {
        OLED_WriteByte(start, OLED_WTYPE_DATA);
        OLED_WriteByte(end, OLED_WTYPE_DATA);
    }
}


void OLED_SetFunctionSelection(u8 fun)
{
    OLED_WriteByte(OLED_CMD_SEL_FUNCTION, OLED_WTYPE_CMD);          // Function Selection
    OLED_WriteByte(fun, OLED_WTYPE_DATA);                           // Default => 0x01
                                                                    // Enable Internal VDD Regulator
}


void OLED_SetSleep(u8 on)
{
    OLED_WriteByte(OLED_CMD_ON_SLEEP | on, OLED_WTYPE_CMD);         // Set Display On/Off
                                                                    // Default => 0xAE
                                                                    // 0xAE (0x00) => Display Off (Sleep Mode On)
                                                                    // 0xAF (0x01) => Display On (Sleep Mode Off)
}


void OLED_SetPhaseLength(u8 len)
{
    OLED_WriteByte(OLED_CMD_SET_PHASE1_2, OLED_WTYPE_CMD);  // Phase 1 (Reset) & Phase 2 (Pre-Charge) Period Adjustment
    OLED_WriteByte(len, OLED_WTYPE_DATA);                   // Default => 0x74 (7 Display Clocks [Phase 2] / 9 Display Clocks [Phase 1])
                                                            // D[3:0] => Phase 1 Period in 5~31 Display Clocks
                                                            // D[7:4] => Phase 2 Period in 3~15 Display Clocks
}

void OLED_SetDisplayClock(u8 div)
{
    OLED_WriteByte(OLED_CMD_SET_CLK_DIV, OLED_WTYPE_CMD);   // Set Display Clock Divider / Oscillator Frequency
    OLED_WriteByte(div, OLED_WTYPE_DATA);                   // Default => 0xD0
                                                            // A[3:0] => Display Clock Divider
                                                            // A[7:4] => Oscillator Frequency
}


void OLED_SetDisplayEnhancementA(u8 vsl, u8 grayMode)
{
    OLED_WriteByte(OLED_CMD_SET_ENHANCE_A, OLED_WTYPE_CMD); // Display Enhancement
    OLED_WriteByte(vsl, OLED_WTYPE_DATA);                   // Default => 0xA2
                                                            // 0xA0 (0x00) => Enable External VSL
                                                            // 0xA2 (0x02) => Enable Internal VSL (Kept VSL Pin N.C.)
    OLED_WriteByte(grayMode, OLED_WTYPE_DATA);              // Default => 0xB5
                                                            // 0xB5 (0xB0) => Normal
                                                            // 0xFD (0xF8) => Enhance Low Gray Scale Display Quality
}

#define OLED_GPIO0_DISIN_HIZ                 0x00
#define OLED_GPIO0_ENIN_HIZ                  0x01
#define OLED_GPIO0_OUT_LOW                   0x02
#define OLED_GPIO0_OUT_HIGH                  0x03
#define OLED_GPIO1_DISIN_HIZ                 0x00
#define OLED_GPIO1_ENIN_HIZ                  0x04
#define OLED_GPIO1_OUT_LOW                   0x08
#define OLED_GPIO1_OUT_HIGH                  0x0C

void OLED_SetGPIO(u8 mode)
{
    OLED_WriteByte(OLED_CMD_SET_GPIO, OLED_WTYPE_CMD);      // General Purpose IO
    OLED_WriteByte(mode, OLED_WTYPE_DATA);                  // Default => 0x0A (GPIO Pins output Low Level.)
}


void OLED_SetPrechargePeriod(u8 period)
{
    OLED_WriteByte(OLED_CMD_SET_SEC_PRECHARGE, OLED_WTYPE_CMD); // Set Second Pre-Charge Period
    OLED_WriteByte(period, OLED_WTYPE_DATA);                    // Default => 0x08 (8 Display Clocks)
}
void OLED_SetPrechargeVoltage(u8 vol)
{
    OLED_WriteByte(OLED_CMD_SET_PRECHARGE_VOL, OLED_WTYPE_CMD); // Set Pre-Charge Voltage Level
    OLED_WriteByte(vol, OLED_WTYPE_DATA);                       // Default => 0x17 (0.50*VCC)
}
void OLED_SetVCOMH(u8 vol)
{
    OLED_WriteByte(OLED_CMD_SET_VCOMH, OLED_WTYPE_CMD);         // Set COM Deselect Voltage Level
    OLED_WriteByte(vol, OLED_WTYPE_DATA);                       // Default => 0x04 (0.80*VCC)
}
void OLED_SetContrastCurrent(u8 cur)
{
    OLED_WriteByte(OLED_CMD_SET_CONTRAST_CUR, OLED_WTYPE_CMD);  // Set Contrast Current
    OLED_WriteByte(cur, OLED_WTYPE_DATA);                       // Default => 0x7F
}
void OLED_SetMasterCurrent(u8 cur)
{
    OLED_WriteByte(OLED_CMD_SET_MASTER_CUR, OLED_WTYPE_CMD);    // Master Contrast Current Control
    OLED_WriteByte(cur, OLED_WTYPE_DATA);                       // Default => 0x0f (Maximum)
}

void OLED_SetMultiplexRatio(u8 ratio)
{
    OLED_WriteByte(OLED_CMD_SET_MUX_RATIO, OLED_WTYPE_CMD);     // Set Multiplex Ratio
    OLED_WriteByte(ratio, OLED_WTYPE_DATA);                     // Default => 0x7F (1/128 Duty)
}



void OLED_SetDisplayEnhancementB(u8 bNormal)
{
    OLED_WriteByte(OLED_CMD_SET_ENHANCE_B, OLED_WTYPE_CMD);     // Display Enhancement
    OLED_WriteByte(bNormal, OLED_WTYPE_DATA);                   // Default => 0xA2
                                                                // 0x82 (0x00) => Reserved
                                                                // 0xA2 (0x20) => Normal
    OLED_WriteByte(0x20, OLED_WTYPE_DATA);
}



void OLED_SetCommandLock(u8 lock)
{
    OLED_WriteByte(OLED_CMD_LOK_CMD, OLED_WTYPE_CMD);           // Set Command Lock
    OLED_WriteByte(lock, OLED_WTYPE_DATA);                      // Default => 0x12
                                                                // 0x12 => Driver IC interface is unlocked from entering command.
                                                                // a0x16 => All Commands are locked except 0xFD.
}


const u8 g_aGrayScaleTable[15] = {0x0C, 0x18, 0x24, 0x30, 0x3C, 0x48, 0x54, 0x60, 0x6C, 0x78, 0x84, 0x90, 0x9C, 0xA8, 0xB4};
void OLED_SetGrayScaleTable(void)
{
    u8 i = 0;
    OLED_WriteByte(OLED_CMD_SET_GRAY_TABLE, OLED_WTYPE_CMD);        // Set Gray Scale Table
    for(i = 0; i < 15; i++)
    {
        OLED_WriteByte(g_aGrayScaleTable[i], OLED_WTYPE_DATA);
    }

    OLED_WriteByte(OLED_CMD_EN_GRAY_TABLE, OLED_WTYPE_CMD);         // Enable Gray Scale Table
}

void OLED_FillRAM(u16 x, u16 y, u8 data)
{
    u8 i = 0, j = 0;

    OLED_SetColAdd(0x00, 0x77);
    OLED_SetRowAdd(0x00, 0x7F);

    OLED_SetWriteRAM();

    for(i = 0; i < (x >> 1); i++)
    {
        for(j = 0; j < y; j++)
        {
            OLED_WriteByte(data, OLED_WTYPE_DATA);
            OLED_WriteByte(data, OLED_WTYPE_DATA);
        }
    }
}



void OLED_DrawFont(u16 x, u16 y, u8 mode, const u8 *pFont)
{
    u16 i = 0, j = 0, k = 0;
    u16 w = 0, h = 0;
    u8 rowByteNum = 0;

    u8 buf[OLED_UTF16_ROW_BYTE << 2] = {0};

    u8 temp = 0;

    x = OLED_GetStartCol(x);

    //设置起始地址x/y
    if(mode == OLED_CHAR_MODE_UTF8)
    {
        OLED_SetColAdd(OLED_COL_OFFSET + x, OLED_COL_OFFSET + OLED_GetUTF8FontEndCol(x));
        OLED_SetRowAdd(y, y + OLED_UTF8_H);
        w = OLED_UTF8_W;
        h = OLED_UTF8_H;
        rowByteNum = OLED_UTF8_ROW_BYTE;
    }
    else
    {
        OLED_SetColAdd(OLED_COL_OFFSET + x, OLED_COL_OFFSET + OLED_GetUTF16FontEndCol(x));
        OLED_SetRowAdd(y, y + OLED_UTF16_H);
        w = OLED_UTF16_W;
        h = OLED_UTF16_H;
        rowByteNum = OLED_UTF16_ROW_BYTE;
    }

    //写RAM
    OLED_SetWriteRAM();

    //写入数据
    //每1个PIX需要4Bit，所以一个BYTE转换到OLED中需要4个字节
    for(j = 0; j < h; j++)
    {
        for(i = 0; i < rowByteNum; i++)
        {
            temp = pFont[j * rowByteNum + i];
            for(k = 0; k < 4; k++)
            {
                if(temp & 0x80)
                {
                    buf[(i << 2) + k] |= (0x0F << 4);
                }
                if(temp & 0x40)
                {
                    buf[(i << 2) + k] |= 0x0F;
                }
                temp = temp << 2;
            }
        }

        //每2个PIX需要8Bit = 1BYTE
        for(i = 0; i < (w >> 1); i++)
        {
            OLED_WriteByte(buf[i], OLED_WTYPE_DATA);
            buf[i] = 0x00;
        }
    }





}

#define OLED_ASCII_TABLE_OFFSET                32
void OLED_DrawString(u16 x, u16 y, u8 mode, u8 *pStr, u8 len)
{
    u8 i = 0;


    if(mode == OLED_CHAR_MODE_UTF8)
    {
        for(i = 0; i < len; i++)
        {
            //OLED使用的ASCII表没有0~31的码值
            //因此，如果有0~31的码值需要显示，就直接使用‘ ’（空格）代替
            if(pStr[i] < OLED_ASCII_TABLE_OFFSET)
            {
                pStr[i] = OLED_ASCII_TABLE_OFFSET;
            }
            OLED_DrawFont(x + i * OLED_UTF8_W, y, mode, g_aOLEDASCII + (pStr[i] - OLED_ASCII_TABLE_OFFSET) * OLED_UTF8_BUF_LEN);
        }
    }
    else
    {
        for(i = 0; i < len; i++)
        {
            OLED_DrawFont(x + i * OLED_UTF16_W, y, mode, pStr + i * OLED_UTF16_BUF_LEN);
        }
    }

}


